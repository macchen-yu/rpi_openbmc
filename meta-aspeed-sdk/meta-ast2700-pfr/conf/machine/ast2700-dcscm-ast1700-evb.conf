## meta-aspeed-sdk/meta-ast2700-pfr/conf/machine/ast2700-dcscm-ast1700-evb.conf
```bitbake
require conf/machine/ast2700-dcscm.conf

# Kernel Build Settings
KERNEL_DEVICETREE = "aspeed/ast2700a1-dcscm_ast1700a1-evb.dtb"
```

## meta-aspeed-sdk/meta-ast2700-sdk/conf/machine/ast2700-a0-default-ast1700-evb.conf
```bitbake
require conf/machine/ast2700-a0-default.conf

# Kernel Build Settings
KERNEL_DEVICETREE = "aspeed/ast2700a0-evb_ast1700a0-evb.dtb"
```

## meta-aspeed-sdk/meta-ast2700-sdk/conf/machine/ast2700-default-ast1700-evb-cdr.conf
```bitbake
require conf/machine/ast2700-default.conf

# Kernel Build Settings
KERNEL_DEVICETREE = "aspeed/ast2700a1-evb_ast1700a1-evb-cdr.dtb"
```

## meta-evb/meta-evb-raspberrypi/conf/layer.conf
```bitbake
# We have a conf and classes directory, add to BBPATH
BBPATH .= ":${LAYERDIR}"

BBFILE_COLLECTIONS += "evb-raspberrypi"
BBFILE_PATTERN_evb-raspberrypi = ""
LAYERSERIES_COMPAT_evb-npcm750 = "kirkstone langdale"
```
